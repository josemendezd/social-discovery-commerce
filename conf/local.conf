## conf/local.conf
```bitbake
#DB
db.default.driver=org.postgresql.Driver
db.default.url=${?DB_DefaultURL}



# Deadbolt
include "play-authenticate/deadbolt.conf"
# SMTP
include "play-authenticate/smtp.conf"
# And play authenticate
include "play-authenticate/mine.conf"
# SITE
site.address="http://localhost:9000"
site.captcha.private=${?ReCaptcha_Private}
site.captcha.public=${?ReCaptcha_Public}
#AMAZON
aws.access.key=${?AWSAccessKeyId}
aws.secret.key=${?AWSSecretKey}
aws.s3.bucket=${?AWS_S3_Bucket}
base.url.format=".s3-us-west-2.amazonaws.com/"

#STRIPE
stripe.api.key="sk_test_8JI50t8ReBHpGxYweWpESYyq"

#MADMIMI
madmimi.api.key=${?MMApiKey}
madmimi.api.username=${?MMApiUserName}
```
